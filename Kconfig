## Kconfig
```kconfig
config GG_O
	tristate "i like di c"
	help
	    Say Y here if you want to use USB AIRcable Bluetooth Dongle.

	    To compile this driver as a module, choose M here: the module
	    will be called aircable.
```
